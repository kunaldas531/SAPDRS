#include <WiFi.h>
#include <ArduinoOTA.h>
#include <U8g2lib.h>
#include <SPI.h>
#include <Adafruit_MPU6050.h>
#include <Adafruit_Sensor.h>
#include <HardwareSerial.h>
#include <TinyGPS++.h>
#include <Wire.h>
#include <freertos/FreeRTOS.h>
#include <freertos/task.h>

const char* ssid = "INFINITY";
const char* password = "Kd8637333961!!";

#define EN1 35
#define IN1 32
#define IN2 33
#define EN2 25
#define IN3 26
#define IN4 27
#define al 34

U8G2_SH1106_128X64_NONAME_F_HW_I2C oled(U8G2_R0, U8X8_PIN_NONE);

Adafruit_MPU6050 mpu;
HardwareSerial SerialGSM(1);
TinyGPSPlus gps;
HardwareSerial SerialGPS(2);


#define GPSBaud 9600

const unsigned char logo[] PROGMEM = {
  0x00, 0x00, 0x00, 0x00, 0x00, 0x00, 0x00, 0x00, 0x00, 0x00, 0x00, 0x00, 0x00, 0x00, 0x00, 0x00,
  0x00, 0x00, 0x00, 0x00, 0x00, 0x00, 0x00, 0x00, 0x00, 0x00, 0x00, 0x00, 0x00, 0x00, 0x00, 0x00,
  0x00, 0x00, 0x00, 0x00, 0x00, 0x00, 0x00, 0x00, 0x00, 0x00, 0x00, 0x00, 0x00, 0x00, 0x00, 0x00,
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  0x00, 0x00, 0x00, 0x00, 0x00, 0x00, 0x00, 0x00, 0x00, 0x00, 0x00, 0x00, 0x00, 0x00, 0x00, 0x00
};

float latitude;
float longitude;


const int led = 23;  // LED pin (white)
const int p = 2;     // PIR sensor pin (green)
//const int a = 2;  // Alcohol sensor pin (blue)
const int button = 13;  // Button pin
const int t1 = 17;      // Ultrasonic sensor 1 trigger pin
const int e1 = 5;       // Ultrasonic sensor 1 echo pin
const int t2 = 16;      // Ultrasonic sensor 2 trigger pin
const int e2 = 4;       // Ultrasonic sensor 2 echo pin

long duration;
float distance;


TaskHandle_t Task1;
TaskHandle_t Task2;

void Task1Code(void* parameter);
void Task2Code(void* parameter);
void sendSMS(const char* phoneNumber);
void alsms(const char* phoneNumber);

void setup() {

  Serial.begin(9600);
  pinMode(button, INPUT_PULLUP);
  pinMode(p, INPUT);
  pinMode(al, INPUT);
  pinMode(e1, INPUT);
  pinMode(t1, OUTPUT);
  pinMode(e2, INPUT);
  pinMode(t2, OUTPUT);
  pinMode(led, OUTPUT);
  pinMode(IN1, OUTPUT);
  pinMode(IN2, OUTPUT);
  pinMode(IN3, OUTPUT);
  pinMode(IN4, OUTPUT);
  pinMode(EN1, OUTPUT);
  pinMode(EN2, OUTPUT);


  oled.begin();
  oled.clear();
  oled.setFont(u8g2_font_ncenB08_tr);
  oled.firstPage();
  do {
    oled.drawBitmap(0, 0, 128 / 8, 64, logo);
  } while (oled.nextPage());

  delay(10000);

  oled.clearBuffer();
  oled.setFont(u8g2_font_ncenB18_tf);
  oled.setCursor(5, 20);
  oled.println("Welcome");
  oled.setCursor(42, 60);
  oled.println("Sir");
  oled.sendBuffer();
  delay(2000);


  SerialGSM.begin(9600, SERIAL_8N1, 19, 18);
  SerialGPS.begin(9600, SERIAL_8N1, 14, 12);
  delay(100);


  if (!mpu.begin()) {
    Serial.println("Failed to find MPU6050 chip");
    while (1) delay(10);
  }


  mpu.setAccelerometerRange(MPU6050_RANGE_8_G);
  mpu.setGyroRange(MPU6050_RANGE_500_DEG);
  mpu.setFilterBandwidth(MPU6050_BAND_21_HZ);
  Serial.println("Sensor initialized.");
  oled.clearBuffer();
  oled.setFont(u8g2_font_ncenB14_tf);
  oled.setCursor(20, 15);
  oled.println("Sensor");
  oled.setCursor(5, 50);
  oled.println("Initialized");
  oled.sendBuffer();
  delay(3000);


  Serial.println("Booting");

  oled.clearBuffer();
  oled.setFont(u8g2_font_ncenB18_tf);

  oled.setCursor(5, 40);
  oled.println("Booting...");
  oled.sendBuffer();
  delay(2000);


  WiFi.begin(ssid, password);
  while (WiFi.status() != WL_CONNECTED) {
    delay(1000);
    Serial.println("Connecting to WiFi...");
  }
  Serial.println("Connected to WiFi");
  oled.clearBuffer();
  oled.setFont(u8g2_font_ncenB12_tf);
  oled.setCursor(0, 20);
  oled.println("Connected");
  oled.setCursor(40, 40);
  oled.println("To");
  oled.setCursor(40, 60);
  oled.println("WIFI..");
  oled.sendBuffer();
  delay(1000);

  ArduinoOTA.onStart([]() {
    String type;
    if (ArduinoOTA.getCommand() == U_FLASH) {
      type = "sketch";
    } else {
      type = "filesystem";
    }
    Serial.println("Start updating " + type);
  });

  ArduinoOTA.onEnd([]() {
    Serial.println("\nEnd");
  });

  ArduinoOTA.onProgress([](unsigned int progress, unsigned int total) {
    Serial.printf("Progress: %u%%\r", (progress / (total / 100)));
  });

  ArduinoOTA.onError([](ota_error_t error) {
    Serial.printf("Error[%u]: ", error);
    if (error == OTA_AUTH_ERROR) Serial.println("Auth Failed");
    else if (error == OTA_BEGIN_ERROR) Serial.println("Begin Failed");
    else if (error == OTA_CONNECT_ERROR) Serial.println("Connect Failed");
    else if (error == OTA_RECEIVE_ERROR) Serial.println("Receive Failed");
    else if (error == OTA_END_ERROR) Serial.println("End Failed");
  });


  ArduinoOTA.begin();

  oled.clearBuffer();
  oled.setFont(u8g2_font_ncenB18_tf);
  oled.setCursor(2, 20);
  oled.println("OTA");
  oled.setCursor(2, 60);
  oled.println("Ready...");
  oled.sendBuffer();
  delay(2000);

  Serial.println("OTA ready");
  Serial.print("IP address: ");
  Serial.println(WiFi.localIP());


  xTaskCreatePinnedToCore(Task1Code, "Task1", 10000, NULL, 1, &Task1, 0);
  xTaskCreatePinnedToCore(Task2Code, "Task2", 10000, NULL, 1, &Task2, 1);
}

void loop() {}

void Task1Code(void* parameter) {
  while (1) {
    ArduinoOTA.handle();

    while (SerialGPS.available() > 0) {
      gps.encode(SerialGPS.read());

      if (gps.location.isUpdated()) {

        latitude = gps.location.lat();
        longitude = gps.location.lng();
      }
    }


    sensors_event_t a, g, temp;
    mpu.getEvent(&a, &g, &temp);


    if (abs(g.gyro.x) > 2.5 || abs(g.gyro.y) > 2 || abs(g.gyro.z) > 2) {



      oled.clearBuffer();
      oled.setCursor(2, 10);
      oled.setFont(u8g2_font_ncenB10_tf);
      oled.println("Accedent Alert!!!");
      oled.setCursor(30, 30);
      oled.println("Send SMS");
      // oled.setCursor(2, 0);
      // oled.println("To");
      oled.setCursor(22, 50);
      oled.println("TO Hospital");
      oled.sendBuffer();
      sendSMS("+919064564189");
      delay(6000);

      oled.clearBuffer();
      oled.setCursor(2, 10);
      oled.println("Accedent Alert!!!");
      oled.setCursor(23, 30);
      oled.println("Send SMS");
      // oled.setCursor(40, 40);
      // oled.println("To");
      oled.setCursor(20, 50);
      oled.println("To Police");
      oled.sendBuffer();
      sendSMS("+918637333961");
      delay(6000);

      oled.clearBuffer();
      oled.setCursor(2, 10);
      oled.println("Accedent Alert!!!");
      oled.setCursor(20, 30);
      oled.println("Send SMS To");
      // oled.setCursor(40, 40);
      // oled.println("To");
      oled.setCursor(2, 50);
      oled.println("Family Member");
      oled.sendBuffer();
      sendSMS("+918918673369");
      delay(6000);

    } else {

      oled.clearBuffer();
      oled.setFont(u8g2_font_ncenB12_tf);
      oled.setCursor(5, 20);
      oled.println("Safe Drive");
      oled.setCursor(40, 60);
      oled.println("Save Life");
      oled.sendBuffer();
      delay(10);
    }
    delay(100);
  }
}


void Task2Code(void* parameter) {
  while (1) {
    ArduinoOTA.handle();
    int pir = digitalRead(p);
    int alc = analogRead(al);
    int b = digitalRead(button);
    int v = alc / 10;
    Serial.println(pir);
    Serial.println(v);
    // oled.clearBuffer();
    // oled.setFont(u8g2_font_ncenB12_tf);
    // oled.setCursor(40, 40);
    // oled.println(pir);
    // oled.sendBuffer();
    // delay(100);
    if (pir == 1) {
      if (v <= 340) {
        if (b == 1) {
          analogWrite(EN1, 100);
          digitalWrite(IN1, HIGH);
          digitalWrite(IN2, LOW);
          delay(100);
          digitalWrite(t1, LOW);
          delayMicroseconds(5);
          digitalWrite(t1, HIGH);
          delayMicroseconds(20);
          digitalWrite(t1, LOW);

          duration = pulseIn(e1, HIGH);
          distance = (duration / 2) * 0.0343;
          delay(100);

          //Serial.println(distance);
          delay(100);

          if (distance <= 5) {

            digitalWrite(led, HIGH);

            delay(100);



            digitalWrite(IN3, LOW);
            digitalWrite(IN4, LOW);

            delay(100);

          } else {
            digitalWrite(led, LOW);

            delay(100);
            analogWrite(EN2, 75);
            digitalWrite(IN3, LOW);
            digitalWrite(IN4, HIGH);
            delay(100);
          }

        } else {
          analogWrite(EN1, 100);
          digitalWrite(IN1, HIGH);
          digitalWrite(IN2, LOW);
          delay(100);
          digitalWrite(t2, LOW);
          delayMicroseconds(5);
          digitalWrite(t2, HIGH);
          delayMicroseconds(20);
          digitalWrite(t2, LOW);

          duration = pulseIn(e2, HIGH);
          distance = (duration / 2) * 0.0343;
          delay(100);

          //Serial.println(distance);
          delay(100);

          if (distance <= 5) {

            digitalWrite(led, HIGH);

            delay(100);

            digitalWrite(IN3, LOW);
            digitalWrite(IN4, LOW);
            delay(100);

          } else {
            digitalWrite(led, LOW);
            analogWrite(EN2, 75);
            digitalWrite(IN4, LOW);
            digitalWrite(IN3, HIGH);
            delay(100);
          }
        }
      } else {
        // sendSMS1("+918637333961","The Driver is drunk.");
        alsms("+918637333961");
        delay(6000);
        // analogWrite(EN1, 150);
        // digitalWrite(IN1, LOW);
        // digitalWrite(IN2, LOW);
        // delay(100);

        digitalWrite(IN3, LOW);
        digitalWrite(IN4, LOW);
        analogWrite(EN1, 100);
        digitalWrite(IN1, LOW);
        digitalWrite(IN2, LOW);
        delay(100);
      }
    } else {
      // sendSMS1("+918637333961","The Driver is drunk.");

      digitalWrite(IN3, LOW);
      digitalWrite(IN4, LOW);
      delay(100);
      analogWrite(EN1, 100);
      digitalWrite(IN1, LOW);
      digitalWrite(IN2, LOW);
      delay(100);
    }

    delay(100);
  }
}


void sendSMS(const char* phoneNumber) {
  String locationLink = "Accident detected!!! -> https://maps.google.com/?q=";
  locationLink += String(latitude, 6) + "," + String(longitude, 6);

  SerialGSM.println("AT+CMGF=1");
  delay(500);
  SerialGSM.print("AT+CMGS=\"");
  SerialGSM.print(phoneNumber);
  SerialGSM.println("\"");
  delay(500);
  SerialGSM.print(locationLink);
  delay(500);
  SerialGSM.write(26);
  delay(500);
  Serial.print("Sent SMS to: ");
  Serial.println(phoneNumber);
  Serial.print("Message: ");
  Serial.println(locationLink);
}

void alsms(const char* phoneNumber) {
  String locationLink = "The Driver is drunk.";
  locationLink += "Location -> https://maps.google.com/?q=";
  locationLink += String(latitude, 6) + "," + String(longitude, 6);

  SerialGSM.println("AT+CMGF=1");
  delay(500);
  SerialGSM.print("AT+CMGS=\"");
  SerialGSM.print(phoneNumber);
  SerialGSM.println("\"");
  delay(500);
  SerialGSM.print(locationLink);
  delay(500);
  SerialGSM.write(26);
  delay(500);
  Serial.print("Sent SMS to: ");
  Serial.println(phoneNumber);
  Serial.print("Message: ");
  Serial.println(locationLink);
}